## firmware/esp32-generic-node/main/Kconfig.projbuild
```kconfig
# Generic IoT Node configuration.
#
# This is the single place where device identity, hardware (GPIO) mapping and
# network settings are defined. Nothing in the C sources hard-codes GPIO numbers
# or identities: every module reads them from here through sm_device / sm_hardware.
#
# Run `idf.py menuconfig` and set:
#   Generic IoT Node -> Device Identity / Hardware / Wi-Fi / MQTT / Time / OTA
#
# sdkconfig is git-ignored because it can contain Wi-Fi/MQTT secrets.

menu "Generic IoT Node"

    menu "Device Identity"
        config NODE_DEVICE_ID
            string "device_id (MQTT/Backend logical identifier)"
            default "esp32-c3-001"
            help
                Must match `devices.device_id` on the Backend.
                Example: esp32-c3-001

        config NODE_HOME_ID
            string "home_id"
            default ""
            help
                Must match the Backend Home resource id.

        config NODE_ROOM_ID
            string "room_id"
            default ""
            help
                Must match the Backend Room resource id.

        config NODE_FIRMWARE_VERSION
            string "FIRMWARE_VERSION (semver, published in capability message)"
            default "1.0.0"
    endmenu

    menu "Hardware Configuration"
        config NODE_DHT11_ENABLED
            bool "DHT11 temperature/humidity sensor present"
            default y

        config NODE_DHT11_GPIO
            depends on NODE_DHT11_ENABLED
            int "DHT11_GPIO (DATA pin)"
            default 4
            range 0 21
            help
                ESP32-C3 GPIO used for the single-wire DHT11 DATA line.
                Needs a 4.7k-10k pull-up to 3V3 (most DHT11 breakout boards have it).

        config NODE_RELAY_COUNT
            int "Number of relay instances on this node"
            default 1
            range 0 8
            help
                0 = sensor-only node; up to eight independently controlled relays.
                Relay instance codes are relay_1 .. relay_N.

        config NODE_RELAY_1_GPIO
            depends on NODE_RELAY_COUNT >= 1
            int "RELAY_1_GPIO"
            default 0
            range 0 21

        config NODE_RELAY_2_GPIO
            depends on NODE_RELAY_COUNT >= 2
            int "RELAY_2_GPIO"
            default 1
            range 0 21

        config NODE_RELAY_3_GPIO
            depends on NODE_RELAY_COUNT >= 3
            int "RELAY_3_GPIO"
            default 3
            range 0 21

        config NODE_RELAY_4_GPIO
            depends on NODE_RELAY_COUNT >= 4
            int "RELAY_4_GPIO"
            default 5
            range 0 21

        config NODE_RELAY_5_GPIO
            depends on NODE_RELAY_COUNT >= 5
            int "RELAY_5_GPIO"
            default 6
            range 0 21

        config NODE_RELAY_6_GPIO
            depends on NODE_RELAY_COUNT >= 6
            int "RELAY_6_GPIO"
            default 7
            range 0 21

        config NODE_RELAY_7_GPIO
            depends on NODE_RELAY_COUNT >= 7
            int "RELAY_7_GPIO"
            default 10
            range 0 21

        config NODE_RELAY_8_GPIO
            depends on NODE_RELAY_COUNT >= 8
            int "RELAY_8_GPIO"
            default 11
            range 0 21

        config NODE_RELAY_ACTIVE_HIGH
            bool "Relay module is active HIGH"
            default y
            help
                Most relay boards are active LOW (relay ON = GPIO low).
    endmenu

    menu "Telemetry"
        config NODE_TELEMETRY_INTERVAL
            int "Default telemetry interval (seconds)"
            default 30
            range 5 3600
            help
                MQTT_SPEC.md default interval. Can be changed at runtime by a
                `config` message (telemetry_interval key).
    endmenu

    menu "Wi-Fi"
        config NODE_BACKEND_URL
            string "Backend URL reachable from ESP after Wi-Fi joins"
            default "http://192.168.1.10:3001"
            help
                Set the computer's LAN IP, not localhost. The ESP uses this URL
                for pairing and recovery when MQTT broker changes.

        config NODE_WIFI_SSID
            string "WiFi SSID (empty = configure from phone)"
            default ""
            help
                Credentials entered in the phone provisioning portal are stored
                in NVS and always win. Leave this empty to let a phone configure
                the node over its own access point after flashing.

        config NODE_WIFI_PASSWORD
            string "WiFi password"
            default ""

        config NODE_WIFI_MAX_RETRY
            int "WiFi reconnect backoff base (seconds)"
            default 5
            range 1 60

        config NODE_PROVISION_ENABLED
            bool "Open provisioning access point when no Wi-Fi is stored"
            default y
            help
                When NVS has no Wi-Fi credentials the node starts its own access
                point (SoftAP) and serves a web form at http://192.168.4.1.
                The phone joins that network, submits SSID/password, and the node
                stores them and reboots into station mode.

        config NODE_PROVISION_AP_PASSWORD
            string "Provisioning access point password (min 8 chars, empty = open)"
            default "smarthome123"
            help
                This is the password of the temporary access point the node
                creates for setup, not the home Wi-Fi password.

        config NODE_PROVISION_PORT
            int "Provisioning web server port"
            default 80
            range 1 65535

        config NODE_WIFI_RESET_BUTTON_ENABLED
            bool "Hold BOOT to reset Wi-Fi or factory settings"
            default y
            help
                After the node has booted normally, hold the configured
                BOOT/reset button. Release after the configured hold duration
                to clear Wi-Fi only, or hold for 15 seconds to erase NVS.

        config NODE_WIFI_RESET_BUTTON_GPIO
            depends on NODE_WIFI_RESET_BUTTON_ENABLED
            int "Wi-Fi reset button GPIO (ESP32-C3 BOOT = 9)"
            default 9
            range 0 21
            help
                Use a GPIO that is not assigned to a relay or sensor. The
                built-in BOOT button is GPIO9 on common ESP32-C3 boards.

        config NODE_WIFI_RESET_HOLD_SECONDS
            depends on NODE_WIFI_RESET_BUTTON_ENABLED
            int "Wi-Fi reset hold duration (seconds)"
            default 5
            range 2 10
            help
                Release BOOT after this duration but before 15 seconds to
                reset only Wi-Fi and reopen the setup portal. Holding BOOT
                  for 15 seconds erases the whole NVS (factory reset).
    endmenu

    menu "MQTT"
        config NODE_MQTT_BROKER_URI
            string "MQTT broker URI (EMQX)"
            default ""
            help
                Examples: mqtt://192.168.1.10:1883 , mqtts://mqtt.example.com:8883

        config NODE_MQTT_USERNAME
            string "MQTT username"
            default ""

        config NODE_MQTT_PASSWORD
            string "MQTT password"
            default ""

        config NODE_MQTT_KEEPALIVE
            int "MQTT keepalive (seconds)"
            default 60
            range 10 3600
    endmenu

    menu "Time"
        config NODE_SNTP_SERVER
            string "SNTP server (required before telemetry is published)"
            default "pool.ntp.org"
    endmenu

    menu "OTA"
        config NODE_OTA_ALLOW_HTTP
            bool "Allow plain HTTP firmware URLs (lab use only)"
            default n
            help
                MQTT_SPEC.md firmware_url is https. Keep this disabled outside
                of a trusted lab network.
    endmenu

endmenu
```
